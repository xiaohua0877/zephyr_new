## CMakeLists.txt
```
# SPDX-License-Identifier: Apache-2.0

cmake_minimum_required(VERSION 3.13.1)

include($ENV{ZEPHYR_BASE}/cmake/app/boilerplate.cmake NO_POLICY_SCOPE)
project(hello_world)

##target_sources(app PRIVATE src/hello_main.c)

##FILE(GLOB app_sources src/*.c)
##target_sources(app PRIVATE ${app_sources})

FILE(GLOB app_sources src/logger/*.c)
FILE(GLOB alarm_sources src/alarm/*.c)
FILE(GLOB bmi160_sources src/bmi160/*.c)
FILE(GLOB shell_sources src/shell/*.c)
target_sources(
    app PRIVATE 
    src/hello_main.c
    src/led_main.c
)
zephyr_library_sources_ifdef(CONFIG_SAMPLES_LOGGER_MAIN     ${app_sources})
zephyr_library_sources_ifdef(CONFIG_SAMPLES_ALARM_MAIN     ${alarm_sources})
zephyr_library_sources_ifdef(CONFIG_SAMPLES_BMI160_MAIN     ${bmi160_sources})
zephyr_library_sources_ifdef(CONFIG_SAMPLES_FS_MAIN          src/fs/fs_main.c)
zephyr_library_sources_ifdef(CONFIG_SYNCHRONIZATION_FS_MAIN          src/synchronization/sync_main.c)
```

## Kconfig
```
# Kconfig - Config options for logger sample app
#
# Copyright (c) 2018 Nordic Semiconductor ASA
#
# SPDX-License-Identifier: Apache-2.0
#

mainmenu "Logger sample application"

menu "Application configuration"

module = SAMPLE_MODULE
module-str = Sample module
source "subsys/logging/Kconfig.template.log_config"

#config SAMPLES_LOGGER_MAIN
#    bool "sample test code loggger main "
#    default y
#    help
#      Enables sample test code loggger main

config SAMPLES_LOGGER_MAIN
    bool "Name of the button GPIO port"
    default y
    help
      Name of the button port for triggering messages.

config SAMPLES_ALARM_MAIN
    bool "alarm Name of the button GPIO port"
    default y
    help
      Name of the button port for triggering messages.
      
config SAMPLES_BMI160_MAIN
    bool "BMI160 Name of the button GPIO port"
    default y
    help
      Name of the button port for triggering messages.      
      
      
config SAMPLES_FS_MAIN
    bool "FS Name of the button GPIO port"
    default n
    help
      Name of the button port for triggering messages.      
  
config SYNCHRONIZATION_FS_MAIN
    bool "FS Name of the button GPIO port"
    default y
    help
      Name of the button port for triggering messages.        
endmenu

source "Kconfig.zephyr"
```

## prj.conf
```kconfig
# nothing here
CONFIG_GPIO=y
CONFIG_PRINTK=y
CONFIG_HEAP_MEM_POOL_SIZE=256
CONFIG_ASSERT=y
CONFIG_FORCE_NO_ASSERT=y
##CONFIG_GPIO=y
```

## prj.stm32f723e.conf
```kconfig
# nothing here
CONFIG_HEAP_MEM_POOL_SIZE=256
CONFIG_PRINTK=y
CONFIG_SHELL=y
CONFIG_LOG=y
CONFIG_KERNEL_SHELL=y
CONFIG_THREAD_MONITOR=y
CONFIG_INIT_STACKS=y
CONFIG_BOOT_BANNER=n
CONFIG_THREAD_NAME=y
CONFIG_DEVICE_SHELL=y
# CONFIG_KERNEL_DEBUG is not set
CONFIG_THREAD_STACK_INFO=y
CONFIG_THREAD_MONITOR=y
CONFIG_DEBUG=y
CONFIG_TRACING=y
CONFIG_STACK_USAGE=y
CONFIG_TRACING_CPU_STATS=y
CONFIG_TRACING_CPU_STATS_LOG=y
CONFIG_TRACING_CPU_STATS_INTERVAL=2000
CONFIG_THREAD_NAME=y

CONFIG_LOG=y
CONFIG_LOG_RUNTIME_FILTERING=y
CONFIG_LOG_BUFFER_SIZE=2048
CONFIG_LOG_PRINTK=y
CONFIG_LOG_PROCESS_TRIGGER_THRESHOLD=0
CONFIG_COVERAGE=n
##添加重启
CONFIG_REBOOT=y

CONFIG_SAMPLES_LOGGER_MAIN=y


CONFIG_PRINTK=y
CONFIG_COUNTER=y
CONFIG_SAMPLES_ALARM_MAIN=y

### 
CONFIG_PRINTK=y
CONFIG_SPI=y
CONFIG_GPIO=y
CONFIG_SENSOR=y
CONFIG_BMI160=y
CONFIG_BMI160_TRIGGER_OWN_THREAD=y
CONFIG_BMI160_TRIGGER=y
#CONFIG_SAMPLES_BMI160_MAIN=


CONFIG_SPI=y
CONFIG_SPI_1=y
CONFIG_DISK_ACCESS=y
CONFIG_DISK_ACCESS_SDHC=y
CONFIG_DISK_SDHC_VOLUME_NAME="SD"
CONFIG_LOG=y
CONFIG_FILE_SYSTEM=y
CONFIG_FAT_FILESYSTEM_ELM=y
CONFIG_PRINTK=y
CONFIG_SAMPLES_FS_MAIN=y


CONFIG_SAMPLES_LOGGER_MAIN=n
CONFIG_SAMPLES_ALARM_MAIN=n
CONFIG_SAMPLES_BMI160_MAIN=n
CONFIG_SAMPLES_FS_MAIN=n
CONFIG_SYNCHRONIZATION_FS_MAIN=n
```

## src/hello_main.c
```c
/*
 * Copyright (c) 2012-2014 Wind River Systems, Inc.
 *
 * SPDX-License-Identifier: Apache-2.0
 */

//#include <zephyr.h>
//#include <misc/printk.h>
#include <zephyr.h>
#include <device.h>
#include <gpio.h>
#include <misc/util.h>
#include <misc/printk.h>

/* change this to use another GPIO port */
#ifndef SW0_GPIO_CONTROLLER
    #ifdef SW0_GPIO_NAME
        #define SW0_GPIO_CONTROLLER SW0_GPIO_NAME
    #else
        #error SW0_GPIO_NAME or SW0_GPIO_CONTROLLER needs to be set in board.h
    #endif
#endif
#define PORT    SW0_GPIO_CONTROLLER

/* change this to use another GPIO pin */
#ifdef SW0_GPIO_PIN
    #define PIN     SW0_GPIO_PIN
#else
    #error SW0_GPIO_PIN needs to be set in board.h
#endif

/* change to use another GPIO pin interrupt config */
#ifdef SW0_GPIO_FLAGS
    #define EDGE    (SW0_GPIO_FLAGS | GPIO_INT_EDGE)
#else
    /*
    * If SW0_GPIO_FLAGS not defined used default EDGE value.
    * Change this to use a different interrupt trigger
    */
    #define EDGE    (GPIO_INT_EDGE | GPIO_INT_ACTIVE_LOW)
#endif

/* change this to enable pull-up/pull-down */
#ifndef SW0_GPIO_FLAGS
    #ifdef SW0_GPIO_PIN_PUD
        #define SW0_GPIO_FLAGS SW0_GPIO_PIN_PUD
    #else
        #define SW0_GPIO_FLAGS 0
    #endif
#endif
#define PULL_UP SW0_GPIO_FLAGS

/* Sleep time */
#define SLEEP_TIME          (500)


void button_pressed(struct device *gpiob, struct gpio_callback *cb,
                    u32_t pins)
{
    printk("Button pressed at %d\n", k_cycle_get_32());
}

static struct gpio_callback gpio_cb;
extern void fs_main(void);
void main(void)
{
    struct device *gpiob;
    K_DEBUG("Hello World! %s\n", CONFIG_BOARD);
    K_DEBUG("Press the user defined button on the board\n");
    gpiob = device_get_binding(PORT);
    if (!gpiob)
    {
        printk("error\n");
        return;
    }

    gpio_pin_configure(gpiob, PIN,
                       GPIO_DIR_IN | GPIO_INT |  PULL_UP | EDGE);

    gpio_init_callback(&gpio_cb, button_pressed, BIT(PIN));

    gpio_add_callback(gpiob, &gpio_cb);
    gpio_pin_enable_callback(gpiob, PIN);

    ///fs_main();

    while (1)
    {
        u32_t val = 0U;

        gpio_pin_read(gpiob, PIN, &val);
        k_sleep(SLEEP_TIME);
    }
}

//void main(void)
//{
//    printk("Hello World! %s\n", CONFIG_BOARD);
//}
```

## src/led_main.c
```c
/*
 * Copyright (c) 2017 Linaro Limited
 *
 * SPDX-License-Identifier: Apache-2.0
 */

#include <zephyr.h>
#include <device.h>
#include <gpio.h>
#include <misc/printk.h>
#include <misc/__assert.h>
#include <string.h>

/* size of stack area used by each thread */
#define STACKSIZE 1024

/* scheduling priority used by each thread */
#define PRIORITY 7

/* Change this if you have an LED connected to a custom port */
#ifndef LED0_GPIO_CONTROLLER
    #define LED0_GPIO_CONTROLLER    LED0_GPIO_PORT
#endif
#ifndef LED1_GPIO_CONTROLLER
    #define LED1_GPIO_CONTROLLER    LED1_GPIO_PORT
#endif

#define PORT0    LED0_GPIO_CONTROLLER
#define PORT1    LED1_GPIO_CONTROLLER


/* Change this if you have an LED connected to a custom pin */
#define LED0    LED0_GPIO_PIN
#define LED1    LED1_GPIO_PIN

struct printk_data_t
{
    void *fifo_reserved; /* 1st word reserved for use by fifo */
    u32_t led;
    u32_t cnt;
};

K_FIFO_DEFINE(printk_fifo);
u32_t run_count1 = 0;
u32_t run_count2 = 0;
u32_t run_count3 = 0;

void blink(const char *port, u32_t sleep_ms, u32_t led, u32_t id)
{
    int cnt = 0;
    struct device *gpio_dev;

    gpio_dev = device_get_binding(port);
    __ASSERT_NO_MSG(gpio_dev != NULL);

    gpio_pin_configure(gpio_dev, led, GPIO_DIR_OUT);

    while (1)
    {
        gpio_pin_write(gpio_dev, led, cnt % 2);

        struct printk_data_t tx_data = { .led = id, .cnt = cnt };
        if (led == LED0)
        {
            run_count1++;
            if (0x0 == run_count1 %1000)
                K_INFO("run to blink   LED0  %d %d \n\r", run_count1, led);
        }
        else if (led == LED1)
        {
            run_count2++;
            if (0x0 == run_count2 %1000)
                K_INFO("run to blink   LED1  %d %d\n\r", run_count2, led);
        }

        size_t size = sizeof(struct printk_data_t);
        char *mem_ptr = k_malloc(size);
        __ASSERT_NO_MSG(mem_ptr != 0);

        memcpy(mem_ptr, &tx_data, size);

        k_fifo_put(&printk_fifo, mem_ptr);

        k_sleep(sleep_ms);
        cnt++;
    }
}

void blink1(void)
{
    //blink(PORT0, 100, LED0, 0);
    //blink(PORT0, 100, LED0, 0);
    blink(PORT0, 300, LED0, 0);
}

void blink2(void)
{
    // blink(PORT1, 1000, LED1, 1);
    blink(PORT1, 400, LED1, 1);
}

void uart_out(void)
{
    while (1)
    {
        struct printk_data_t *rx_data = k_fifo_get(&printk_fifo, K_FOREVER);
        run_count3++;
        if (0 == run_count3 %10000)
        {
            K_INFO("Toggle USR%d LED: Counter = %d\n", rx_data->led, rx_data->cnt);
        }
        k_free(rx_data);
    }
}

K_THREAD_DEFINE(blink1_id, STACKSIZE, blink1, NULL, NULL, NULL,
                PRIORITY + 1, 0, K_NO_WAIT);
K_THREAD_DEFINE(blink2_id, STACKSIZE, blink2, NULL, NULL, NULL,
                PRIORITY, 0, K_NO_WAIT);
K_THREAD_DEFINE(uart_out_id, STACKSIZE, uart_out, NULL, NULL, NULL,
                PRIORITY + 2, 0, K_NO_WAIT);
```
